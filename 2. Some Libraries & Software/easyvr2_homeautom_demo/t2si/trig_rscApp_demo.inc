; HMM Grammar Vocabulary Description file for RSC4
; Version: 25.0
; Copyright (C) 2003-2008 Sensory, Inc. All Rights Reserved.
; Generated by Paolo on Thu Nov 07 10:38:16 2013 - GUI 3.1.7

        .EXTRN (const) gsearch_trig_demo
.IF .NOT .DEFINED NN_DEMO_INC
NN_DEMO_INC .DEFINE 1
        .EXTRN (const) nn_demo;
.ENDIF

G_trig_demo_SILENCE                   .EQU 0
G_trig_demo_HELLO_DEVICE              .EQU  1
G_trig_demo_nota                      .EQU 2

; ======================= Build Log ========================= 
; Timestamp:                    Thu Nov 07 10:38:16 2013 
; Licensed To:                  SantaClaraRep 
; QT2SI GUI:                    3.1.7 
; Fluent Chip:                  3.1.16 
; Quick Synthesis:              0 
; Language:                     US English 
; Acoustic Model:               US English Adults and Kids (464 states) 
; Pronunciation_0:              {{hello device} {. h E . l oU1 . . d I . v aI1 s .}} 
; End-point Detection:          Stop when end of speech is detected (Best) 
; Matching Criteria             Match target phrase exactly (Best) 
; Matching Sensitivity          Normal 
; Out-of-Vocab Sensitivity:     Normal 
; Target Device:                RSC-4128 
; Acoustic Model Memory Space:  const (bank 0) 
; Trigger Grammar Memory Space: const (bank 0) 
; Command Grammar Memory Space: const (bank 0) 
; On-Chip Templates:            0 
; Acoustic Model Size (bytes):  9329 
; Grammar Size (bytes):         228 
; Total Number of States:       29 
; Number of Cyclical States:    0 
; Beam:                         45 
